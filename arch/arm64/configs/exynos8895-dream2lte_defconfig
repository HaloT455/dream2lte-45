## drivers/android/Kconfig
```kconfig
menu "Android"

config ANDROID
	bool "Android Drivers"
	---help---
	  Enable support for various drivers needed on the Android platform

if ANDROID

config ANDROID_BINDER_IPC
	bool "Android Binder IPC Driver"
	depends on MMU && !M68K
	default n
	---help---
	  Binder is used in Android for both communication between processes,
	  and remote method invocation.

	  This means one Android process can call a method/routine in another
	  Android process, using Binder to identify, invoke and pass arguments
	  between said processes.

config ANDROID_BINDER_DEVICES
	string "Android Binder devices"
	depends on ANDROID_BINDER_IPC
	default "binder,hwbinder,vndbinder"
	---help---
	  Default value for the binder.devices parameter.

	  The binder.devices parameter is a comma-separated list of strings
	  that specifies the names of the binder device nodes that will be
	  created. Each binder device has its own context manager, and is
	  therefore logically separated from the other devices.

config ANDROID_BINDER_IPC_SELFTEST
	bool "Android Binder IPC Driver Selftest"
	depends on ANDROID_BINDER_IPC
	---help---
	  This feature allows binder selftest to run.

	  Binder selftest checks the allocation and free of binder buffers
	  exhaustively with combinations of various buffer sizes and
	  alignments.

config ANDROID_SIMPLE_LMK
	bool "Simple Android Low Memory Killer"
	---help---
	  A small in-kernel low memory killer for Android. It selects victims
	  using oom_score_adj, starting with the least important processes, and
	  frees a bounded amount of memory when kswapd reaches critical pressure.

if ANDROID_SIMPLE_LMK

config ANDROID_SIMPLE_LMK_MINFREE
	int "Minimum MiB of memory to free per reclaim"
	range 8 512
	default 128
	help
	  Simple LMK will try to free at least this much memory per reclaim.

config ANDROID_SIMPLE_LMK_TIMEOUT_MSEC
	int "Reclaim timeout in milliseconds"
	range 50 1000
	default 200
	help
	  Maximum time to wait for a victim batch to release its memory before
	  Simple LMK accepts another reclaim request.

config ANDROID_SIMPLE_LMK_KSWAPD_PRIORITY
	int "kswapd priority that triggers reclaim"
	range 1 5
	default 1
	help
	  Trigger Simple LMK when kswapd reaches this scan priority. Priority 1
	  is deliberately conservative for a 4 GiB device.

endif

endif # if ANDROID

endmenu
```

## drivers/block/zram/Kconfig
```kconfig
config ZRAM
	tristate "Compressed RAM block device support"
	depends on BLOCK && SYSFS && ZSMALLOC && CRYPTO
	select CRYPTO_LZO
	default n
	help
	  Creates virtual block devices called /dev/zramX (X = 0, 1, ...).
	  Pages written to these disks are compressed and stored in memory
	  itself. These disks allow very fast I/O and compression provides
	  good amounts of memory savings.

	  It has several use cases, for example: /tmp storage, use as swap
	  disks and maybe many more.

	  See Documentation/blockdev/zram.txt for more information.

config ZRAM_DEF_COMP_LZ4KD
	bool "Use LZ4KD as the default zram compressor"
	depends on ZRAM && ARM64_4K_PAGES && !CPU_BIG_ENDIAN
	select CRYPTO_LZ4KD
	help
	  Start new zram devices with LZ4KD selected on 4 KiB systems.

config ZRAM_WRITEBACK
       bool "Write back incompressible page to backing device"
       depends on ZRAM
       default n
       help
	 With incompressible page, there is no memory saving to keep it
	 in memory. Instead, write it out to backing device.
	 For this feature, admin should set up backing device via
	 /sys/block/zramX/backing_dev.

	 See Documentation/blockdev/zram.txt for more information.

config ZRAM_MEMORY_TRACKING
	bool "Track zRam block status"
	depends on ZRAM && DEBUG_FS
	help
	  With this feature, admin can track the state of allocated blocks
	  of zRAM. Admin could see the information via
	  /sys/kernel/debug/zram/zramX/block_state.

	  See Documentation/blockdev/zram.txt for more information.
```

## kernel/Kconfig.alice
```kconfig
config ALICE_SYSINTEL
	bool "ALICE read-only system and MGLRU diagnostics bridge"
	depends on SYSFS && MMU
	default n
	help
	  Export low-overhead VM reclaim counters through /sys/kernel/alice.
	  The bridge observes MGLRU CPU reclaim and does not change any
	  page table, CPU/GPU/VPU clock, thermal or memory policy.
	  It does not implement GPU/VPU NPU inference or MGLRU offload.
```
